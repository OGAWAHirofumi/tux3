## user/kernel/Kconfig
```kconfig
config TUX3
	tristate "Tux3 Versioning Filesystem"
	help
	  To compile this filesystem as a module, choose M here: the module will
	  be called tux3.

	  If unsure, see you again in six months.

config TUX3_MMAP
	bool "Tux3 mmap support"
	depends on TUX3
	help
	  Adds EXPORT_SYMBOL_GPL(), etc. to provide functionality for mmap.
	  This needs build tux3 as module with support mmap.
```
